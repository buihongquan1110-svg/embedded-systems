#include "stm32f10x.h"
#include <stdio.h>


const uint8_t Font6x8[][6] = {
{0x00,0x00,0x00,0x00,0x00,0x00}, // 32 (space)
{0x00,0x00,0x5F,0x00,0x00,0x00}, // 33 !
{0x00,0x07,0x00,0x07,0x00,0x00}, // 34 "
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{0x08,0x04,0x08,0x10,0x08,0x00}, // 126 ~
};



void UART1_Init(void) {
    GPIO_InitTypeDef gpio;
    USART_InitTypeDef usart;

    RCC_APB2PeriphClockCmd(RCC_APB2Periph_GPIOA | RCC_APB2Periph_USART1, ENABLE);

    // PA9 = TX
    gpio.GPIO_Pin = GPIO_Pin_9;
    gpio.GPIO_Mode = GPIO_Mode_AF_PP;
    gpio.GPIO_Speed = GPIO_Speed_50MHz;
    GPIO_Init(GPIOA, &gpio);

    // PA10 = RX
    gpio.GPIO_Pin = GPIO_Pin_10;
    gpio.GPIO_Mode = GPIO_Mode_IN_FLOATING;
    GPIO_Init(GPIOA, &gpio);

    usart.USART_BaudRate = 115200;
    usart.USART_WordLength = USART_WordLength_8b;
    usart.USART_StopBits = USART_StopBits_1;
    usart.USART_Parity = USART_Parity_No;
    usart.USART_HardwareFlowControl = USART_HardwareFlowControl_None;
    usart.USART_Mode = USART_Mode_Tx | USART_Mode_Rx;
    USART_Init(USART1, &usart);
    USART_Cmd(USART1, ENABLE);
}

void UART1_SendChar(char c) {
    while (!(USART1->SR & USART_SR_TXE));
    USART1->DR = c;
}

void UART1_SendString(char *s) {
    while (*s) UART1_SendChar(*s++);
}


void SPI1_Init(void) {
    GPIO_InitTypeDef gpio;
    SPI_InitTypeDef spi;

    RCC_APB2PeriphClockCmd(RCC_APB2Periph_GPIOA | RCC_APB2Periph_SPI1, ENABLE);

    // PA5 = SCK, PA7 = MOSI
    gpio.GPIO_Pin = GPIO_Pin_5 | GPIO_Pin_7;
    gpio.GPIO_Mode = GPIO_Mode_AF_PP;
    gpio.GPIO_Speed = GPIO_Speed_50MHz;
    GPIO_Init(GPIOA, &gpio);

    // PA6 = MISO
    gpio.GPIO_Pin = GPIO_Pin_6;
    gpio.GPIO_Mode = GPIO_Mode_IN_FLOATING;
    GPIO_Init(GPIOA, &gpio);

    // PA4 = CS
    gpio.GPIO_Pin = GPIO_Pin_4;
    gpio.GPIO_Mode = GPIO_Mode_Out_PP;
    gpio.GPIO_Speed = GPIO_Speed_50MHz;
    GPIO_Init(GPIOA, &gpio);
    GPIO_SetBits(GPIOA, GPIO_Pin_4);

    spi.SPI_Direction = SPI_Direction_2Lines_FullDuplex;
    spi.SPI_Mode = SPI_Mode_Master;
    spi.SPI_DataSize = SPI_DataSize_8b;
    spi.SPI_CPOL = SPI_CPOL_Low;
    spi.SPI_CPHA = SPI_CPHA_1Edge;
    spi.SPI_NSS = SPI_NSS_Soft;
    spi.SPI_BaudRatePrescaler = SPI_BaudRatePrescaler_16;
    spi.SPI_FirstBit = SPI_FirstBit_MSB;
    spi.SPI_CRCPolynomial = 7;
    SPI_Init(SPI1, &spi);
    SPI_Cmd(SPI1, ENABLE);
}

uint8_t SPI1_Transfer(uint8_t data) {
    while (!(SPI1->SR & SPI_SR_TXE));
    SPI1->DR = data;
    while (!(SPI1->SR & SPI_SR_RXNE));
    return SPI1->DR;
}

// ================= OLED SSD1306 =================
#define OLED_CS_LOW()   GPIO_ResetBits(GPIOA, GPIO_Pin_4)
#define OLED_CS_HIGH()  GPIO_SetBits(GPIOA, GPIO_Pin_4)
#define OLED_DC_LOW()   GPIO_ResetBits(GPIOB, GPIO_Pin_0)  // DC
#define OLED_DC_HIGH()  GPIO_SetBits(GPIOB, GPIO_Pin_0)
#define OLED_RES_LOW()  GPIO_ResetBits(GPIOB, GPIO_Pin_1)  // RST
#define OLED_RES_HIGH() GPIO_SetBits(GPIOB, GPIO_Pin_1)

void OLED_WriteCmd(uint8_t cmd) {
    OLED_DC_LOW();
    OLED_CS_LOW();
    SPI1_Transfer(cmd);
    OLED_CS_HIGH();
}

void OLED_WriteData(uint8_t data) {
    OLED_DC_HIGH();
    OLED_CS_LOW();
    SPI1_Transfer(data);
    OLED_CS_HIGH();
}

void OLED_Init(void) {
    GPIO_InitTypeDef gpio;
    RCC_APB2PeriphClockCmd(RCC_APB2Periph_GPIOB, ENABLE);

    gpio.GPIO_Pin = GPIO_Pin_0 | GPIO_Pin_1; // DC, RST
    gpio.GPIO_Mode = GPIO_Mode_Out_PP;
    gpio.GPIO_Speed = GPIO_Speed_50MHz;
    GPIO_Init(GPIOB, &gpio);

    // reset
    OLED_RES_LOW(); for (volatile int i = 0; i < 10000; i++);
    OLED_RES_HIGH();

    // init sequence
    OLED_WriteCmd(0xAE);
    OLED_WriteCmd(0xD5); OLED_WriteCmd(0x80);
    OLED_WriteCmd(0xA8); OLED_WriteCmd(0x3F);
    OLED_WriteCmd(0xD3); OLED_WriteCmd(0x00);
    OLED_WriteCmd(0x40);
    OLED_WriteCmd(0x8D); OLED_WriteCmd(0x14);
    OLED_WriteCmd(0x20); OLED_WriteCmd(0x00);
    OLED_WriteCmd(0xA1);
    OLED_WriteCmd(0xC8);
    OLED_WriteCmd(0xDA); OLED_WriteCmd(0x12);
    OLED_WriteCmd(0x81); OLED_WriteCmd(0xCF);
    OLED_WriteCmd(0xD9); OLED_WriteCmd(0xF1);
    OLED_WriteCmd(0xDB); OLED_WriteCmd(0x40);
    OLED_WriteCmd(0xA4);
    OLED_WriteCmd(0xA6);
    OLED_WriteCmd(0xAF);
}

void OLED_Clear(void) {
    for (uint8_t page = 0; page < 8; page++) {
        OLED_WriteCmd(0xB0 + page);
        OLED_WriteCmd(0x00);
        OLED_WriteCmd(0x10);
        for (uint8_t col = 0; col < 128; col++) {
            OLED_WriteData(0x00);
        }
    }
}

void OLED_DrawChar(uint8_t x, uint8_t y, char ch) {
    OLED_WriteCmd(0xB0 + y);
    OLED_WriteCmd(((x & 0xF0) >> 4) | 0x10);
    OLED_WriteCmd((x & 0x0F) | 0x01);
    for (uint8_t i = 0; i < 6; i++) {
        OLED_WriteData(Font6x8[ch - 32][i]);
    }
}

void OLED_DrawString(uint8_t x, uint8_t y, char *str) {
    while (*str) {
        OLED_DrawChar(x, y, *str++);
        x += 6;
    }
}

// ================= Timer2 =================
volatile uint8_t flag_timer = 0;

void Timer2_Init(void) {
    TIM_TimeBaseInitTypeDef tim;
    NVIC_InitTypeDef nvic;

    RCC_APB1PeriphClockCmd(RCC_APB1Periph_TIM2, ENABLE);

    tim.TIM_Prescaler = 7200 - 1;   // 72MHz/7200 = 10kHz
    tim.TIM_Period = 10000 - 1;     // 10kHz/10000 = 1Hz
    tim.TIM_CounterMode = TIM_CounterMode_Up;
    tim.TIM_ClockDivision = TIM_CKD_DIV1;
    TIM_TimeBaseInit(TIM2, &tim);

    TIM_ITConfig(TIM2, TIM_IT_Update, ENABLE);

    nvic.NVIC_IRQChannel = TIM2_IRQn;
    nvic.NVIC_IRQChannelPreemptionPriority = 0;
    nvic.NVIC_IRQChannelSubPriority = 1;
    nvic.NVIC_IRQChannelCmd = ENABLE;
    NVIC_Init(&nvic);

    TIM_Cmd(TIM2, ENABLE);
}

void TIM2_IRQHandler(void) {
    if (TIM_GetITStatus(TIM2, TIM_IT_Update) != RESET) {
        TIM_ClearITPendingBit(TIM2, TIM_IT_Update);
        flag_timer = 1;
    }
}

// ================= MAIN =================
int main(void) {
    char buf[32];
    uint8_t tx = 0x55, rx;

    UART1_Init();
    SPI1_Init();
    OLED_Init();
    OLED_Clear();
    Timer2_Init();

    UART1_SendString("STM32 SPI + UART + OLED demo\r\n");
    OLED_DrawString(0, 0, "JUST FOR FUN");

    while (1) {
        if (flag_timer) {
            flag_timer = 0;

            OLED_CS_LOW();
            rx = SPI1_Transfer(tx);
            OLED_CS_HIGH();

            sprintf(buf, "TX=0x%02X, RX=0x%02X\r\n", tx, rx);
            UART1_SendString(buf);

            tx++;
        }
    }
}